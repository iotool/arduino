// Arduino Uno - test step signal reader
// 
// This sketch analyse what kind of pulse wide the arduino able to detect at 16 mhz.
// There are 8 pulse wides generated by 500 mhz with a second arduino at 16 mhz.
// https://github.com/iotool/arduino/atmega328p/test-step-signal-wide/
// 
// Pulse-Wide     Pulse-Count  Pulse-Wide  Note
// Pin00 (0us)    75-95        7us         80% missing pulses
// Pin01 (1us)    495-498      8us         1% missing pulses
// Pin02 (5us)    494-498      8us         1% missing pulses
// Pin03 (10us)   489-499      14us        ok
// Pin04 (50us)   489-499      52us        ok => pulse wide for 16 mhz driver
// Pin05 (100us)  489-499      104us       ok => pulse wide for 8 mhz driver
// Pin06 (500us)  489-499      504us       ok
// Pin07 (500us)  489-499      1004us      ok
// Pin13 (250ms)  2-3          257ms       gap
// 
// 175.000 reads per second (every 6 microsecond)

#define PIN_STEP_X 14 /* ADC0 PortC.0 IC23(R6) */
#define PIN_STEP_Y 15 /* ADC1 PortC.1 IC24(R5) */
#define PIN_STEP_Z 16 /* ADC2 PortC.2 IC25(R4) */
#define PIN_DIR_X  17 /* ADC3 PortC.3 IC26(R3) */
#define PIN_DIR_Y  18 /* ADC4 PortC.4 IC27(R2) */
#define PIN_DIR_Z  19 /* ADC5 PortC.5 IC28(R1) */

void setup() {
  pinMode(PIN_STEP_X,INPUT_PULLUP); 
  pinMode(PIN_STEP_Y,INPUT_PULLUP); 
  pinMode(PIN_STEP_Z,INPUT_PULLUP);  
  pinMode(PIN_DIR_X,INPUT_PULLUP);  
  pinMode(PIN_DIR_Y,INPUT_PULLUP);  
  pinMode(PIN_DIR_Z,INPUT_PULLUP);
  pinMode(13,OUTPUT);  
  Serial.begin(9600);  
  while(!Serial) {delay(1);}  
}

void loop() {
  // --- fast read dir/step signal ---
  uint8_t readPINC = 0;
  unsigned long exitMicros = micros()+1000000;
  unsigned long currentMicros = 0;
  unsigned long countPulseStart = 0;
  unsigned long countPulseEnd = 0;
  unsigned long microsPulseStart = 0;
  unsigned long microsPulseEnd = 0;
  unsigned long microsPulseWide = 0;
  unsigned long countPulseWide = 0;
  unsigned long countReads = 0;
  byte lastStepX = 0;
  byte thisStepX = 0;
  while(exitMicros > currentMicros) {
    countReads++;
    currentMicros = micros();
    readPINC = PINC; // read all adc pins at once
    thisStepX = bitRead(readPINC,PIN_STEP_X-14); // bit 0 at port c
    if (thisStepX > lastStepX) { /* low to high (start of pulse) */
      countPulseStart++;
      microsPulseStart = currentMicros;
    }
    if (thisStepX < lastStepX) { /* high to low (end of pulse) */
      countPulseEnd++;
      if (microsPulseStart >= microsPulseEnd) {
        microsPulseEnd = currentMicros;
        microsPulseWide += (microsPulseEnd-microsPulseStart); 
        countPulseWide++;
      }
    }
    lastStepX = thisStepX; 
  }
  Serial.print(countReads); Serial.print(" ");       // reads per seconds 
  Serial.print(countPulseStart); Serial.print(" ");  // count pulse start
  Serial.print(countPulseEnd); Serial.print(" ");    // count pulse end
  Serial.print(countPulseWide); Serial.print(" ");   // count pulse messure
  if (countPulseWide >= 1) {                         // avg pulse wide
    Serial.print(microsPulseWide/countPulseWide); 
  } else { 
    Serial.print(0); 
  }
  Serial.print(" ");   
  if (countPulseWide == countPulseStart) { 
    if (countPulseWide == countPulseEnd) {
      Serial.print(0); // no error
    } else {
      Serial.print(1);
    }
  } else {
    Serial.print(2);
  }
  Serial.println();
}